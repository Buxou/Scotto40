## boards/shields/Scotto40/Kconfig.shield
```kconfig
# Copyright (c) 2020 The ZMK Contributors
# SPDX-License-Identifier: MIT

config SHIELD_Scotto40
    def_bool $(shields_list_contains,scotto40)
```
